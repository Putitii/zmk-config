## boards/shields/blank-slate_dongle/Kconfig.shield
```kconfig
config SHIELD_BLANK_SLATE_KB
    def_bool $(shields_list_contains,blank-slate_kb)

config SHIELD_BLANK_SLATE_DONGLE
    def_bool $(shields_list_contains,blank-slate_dongle)
```

## boards/shields/dactyl_dongle/Kconfig.shield
```kconfig
config SHIELD_DACTYL_LEFT
    def_bool $(shields_list_contains,dactyl_left)

config SHIELD_DACTYL_RIGHT
    def_bool $(shields_list_contains,dactyl_right)

config SHIELD_DACTYL_DONGLE
    def_bool $(shields_list_contains,dactyl_dongle)
```

## boards/shields/dactyls/Kconfig.shield
```kconfig
config SHIELD_DACTYLS_LEFT
    def_bool $(shields_list_contains,dactyls_left)

config SHIELD_DACTYLS_RIGHT
    def_bool $(shields_list_contains,dactyls_right)
```

## boards/shields/haploinsufficient/Kconfig.defconfig
```kconfig
# Copyright (c) 2022 The ZMK Contributors
# SPDX-License-Identifier: MIT

if SHIELD_CHOC-CORNE_LEFT

config ZMK_KEYBOARD_NAME
	default "choc-corne"

config ZMK_SPLIT_BLE_ROLE_CENTRAL
	default y

endif

if SHIELD_CHOC-CORNE_LEFT || SHIELD_CHOC-CORNE_RIGHT

config ZMK_SPLIT
	default y

endif
```

## boards/shields/haploinsufficient/Kconfig.shield
```kconfig
# Copyright (c) 2022 The ZMK Contributors
# SPDX-License-Identifier: MIT

config SHIELD_CHOC-CORNE_LEFT
	def_bool $(shields_list_contains,choc-corne_left)

config SHIELD_CHOC-CORNE_RIGHT
	def_bool $(shields_list_contains,choc-corne_right)
```

## config/boards/arm/lpgalaxy_blank_slate/Kconfig.defconfig
```kconfig
# Copyright (c) 2020 Pete Johanson
# SPDX-License-Identifier: MIT

if BOARD_LPGALAXY_BLANK_SLATE



config BOARD
    default "lpgalaxy_blank_slate"

if USB_DEVICE_STACK

config USB_NRFX
    default y

endif # USB_DEVICE_STACK

config BT_CTLR
    default BT


config ZMK_BLE
	default y

config ZMK_USB
	default y


endif # BOARD_LPGALAXY_BLANK_SLATE
```

## config/boards/shields/blank-slate_dongle/Kconfig.defconfig
```kconfig
if SHIELD_BLANK_SLATE_DONGLE
	config ZMK_KEYBOARD_NAME
		default "Slate Dongle"
	
	# config ZMK_SPLIT_ROLE_CENTRAL
   	# 	default y
endif

# if SHIELD_BLANK_SLATE_KB || SHIELD_BLANK_SLATE_DONGLE
# 	config ZMK_SPLIT
#    		default y
# endif

# if SHIELD_BLANK_SLATE_KB 
# 	config ZMK_KEYBOARD_NAME
#     	default "slate_single"
# endif
```

## config/boards/shields/blank_slate_dongle/Kconfig.shield
```kconfig
config SHIELD_BLANK_SLATE_KB
    def_bool $(shields_list_contains,blank_slate_kb)

config SHIELD_BLANK_SLATE_DONGLE
    def_bool $(shields_list_contains,blank_slate_dongle)
```

## config/boards/shields/putiti36_choc/Kconfig.defconfig
```kconfig
if SHIELD_PUTITI36_CHOC

config ZMK_KEYBOARD_NAME
	default "putiti36_choc"
endif
```

## config/boards/shields/putiti40/Kconfig.shield
```kconfig
config SHIELD_PUTITI40_KB
    def_bool $(shields_list_contains,putiti40_kb)

config SHIELD_PUTITI40_DONGLE
    def_bool $(shields_list_contains,putiti40_dongle)
```

## config/boards/shields/putiti48_choc/Kconfig.defconfig
```kconfig
if SHIELD_PUTITI48_CHOC
	config ZMK_KEYBOARD_NAME
		default "putiti48_choc"
endif
```

## config/boards/shields/rev41_oled/Kconfig.defconfig
```kconfig
if SHIELD_REVIUNG41_OLED
config ZMK_KEYBOARD_NAME
    default "Rev41_OLED"  
endif

if ZMK_DISPLAY
config I2C
	default y
config SSD1306
	default y

#config SSD1306_REVERSE_MODE
#	default y

endif # ZMK_DISPLAY

if LVGL
config LV_Z_VDB_SIZE
	default 64
config LV_DPI_DEF
	default 148
config LV_Z_BITS_PER_PIXEL
	default 1
choice LVGL_COLOR_DEPTH
	default LV_COLOR_DEPTH_1
endchoice
endif # LVGL
```

## config/boards/shields/rev41_oled/Kconfig.shield
```kconfig
config SHIELD_REVIUNG41_OLED
    def_bool $(shields_list_contains,reviung41_oled)
```
