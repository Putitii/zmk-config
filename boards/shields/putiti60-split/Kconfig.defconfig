## boards/shields/putiti60-split/Kconfig.defconfig
```kconfig
if SHIELD_PUTITI60-SPLIT_LEFT

# Name must be less than 16 characters long!
config ZMK_KEYBOARD_NAME
    default "Putiti60 Split"

config ZMK_SPLIT_ROLE_CENTRAL
    default y

endif

config ZMK_SPLIT
    default y

# --------------------------------

# if ZMK_DISPLAY

# config I2C
#     default y

# config SSD1306
#     default y

# choice ZMK_DISPLAY_WORK_QUEUE
#     default ZMK_DISPLAY_WORK_QUEUE_DEDICATED
# endchoice

# endif # ZMK_DISPLAY

# --------------------------------

# if LVGL

# config LV_Z_VDB_SIZE
#     default 64

# config LV_DPI_DEF
#     default 148

# config LV_Z_BITS_PER_PIXEL
#     default 1

# choice LV_COLOR_DEPTH
#     default LV_COLOR_DEPTH_1
# endchoice

# endif # LVGL
```

## config/west.yml
```yaml
manifest:
  remotes:
    - name: zmkfirmware
      url-base: https://github.com/zmkfirmware
    # - name: manna-harbour
    #   url-base: https://github.com/manna-harbour

    # nice_oled - nice_epaper - dongle_display!view - oled Adapter
    # - name: mctechnology17
    #   url-base: https://github.com/mctechnology17
  projects:
    - name: zmk
      remote: zmkfirmware
      revision: main
      import: app/west.yml
    # oled Adapter
    # - name: zmk-oled-adapter
    #   remote: mctechnology17
    #   revision: main

    # - name: zmk
    #   remote: manna-harbour
    #   revision: zephyr-3.0
    #   import: app/west.yml
  self:
    path: config
```
