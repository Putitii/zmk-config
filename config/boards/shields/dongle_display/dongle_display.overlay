
&pro_micro_i2c {
    status = "okay";
    oled: ssd1306@3c {
        compatible = "solomon,ssd1306fb";
        reg = <0x3c>;
        width = <128>;
        height = <32>;
        segment-offset = <0>;
        page-offset = <0>;
        display-offset = <0>;
        multiplex-ratio = <31>;
        //segment-remap; // Enable horizontal flip 
        //com-invdir; // Enable vertical flip
        com-sequential; 
        inversion-on; // Turn screen to white in black
        prechargep = <0x22>; // Precharge period
    };
};
