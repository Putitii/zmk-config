#include <dt-bindings/zmk/matrix_transform.h>
#include "dactyl.dtsi"

/ {
    chosen {
        zmk,kscan = &mock_kscan;
        zmk,physical-layout = &layout_dactyl_5x10plus5;
        zephyr,display = &oled;
    };

    mock_kscan: kscan_1 {
        compatible = "zmk,kscan-mock";
        columns = <0>;
        rows = <0>;
        events = <0>;
    };
    // /delete-node/ &default_kscan;   // only required if the dongle uses a 
};

