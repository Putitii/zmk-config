#include "dactyl.dtsi"

&default_transform { // The matrix transform for this board is 5
    col-offset = <5>;
};

&kscan0 {
    col-gpios
        = <&gpio1 13 GPIO_ACTIVE_HIGH>
        , <&gpio1 15 GPIO_ACTIVE_HIGH>
        , <&gpio0 2  GPIO_ACTIVE_HIGH>
        , <&gpio0 29 GPIO_ACTIVE_HIGH>
        , <&gpio0 31 GPIO_ACTIVE_HIGH>
    ;
};